#include <Adafruit_GFX.h>   
#include <RGBmatrixPanel.h>
#include <avr/pgmspace.h>

#define CLK 8  // MUST be on PORTB! (Use pin 11 on Mega)
#define OE  9
#define LAT 10
#define A   A0
#define B   A1
#define C   A2
#define D   A3

RGBmatrixPanel matrix(A, B, C, D, CLK, LAT, OE, false);

//initialize the size of the matrix and color palettes
static const int dim = 32;
static const int Red[] = {20, 0, 78, 0};
static const int Grn[] = {20, 0, 80, 0};
static const int Blu[] = {20, 68, 190, 120};

//This is the image we want to display stored in a compressed format
//the associated matlab script is what generated this script from bitmap
static const uint8_t PROGMEM img[] = 
{
0x0,  0x0,  0x5,  0xAA, 0xAA, 0x50, 0x0,  0x0,
0x0,  0x0,  0x16, 0xAA, 0xAA, 0x94, 0x0,  0x0,
0x0,  0x0,  0x5A, 0xAA, 0xAA, 0xA5, 0x0,  0x0,
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0x0,  0x0,  0x5,  0xAA, 0xAA, 0x94, 0x0,  0x0,

};

void setup() 
{
//Set up matrix and serial monitor
matrix.begin();
Serial.begin(9600);

//initialize variables used below
int byteCounter = 0;
int currentByte;
int Nibbles[4] = {0,0,0,0};

//cycle through each row of the matrix
for(int i = 0; i<dim; i++)
{
  //select each set of four lights in the row
  for(int j = 0; j<(dim/4); j++)
  {
    //load the next byte in the image format into this variable
    currentByte = pgm_read_word_near(img + (8*i + j));
    //mask the loaded byte and shift into the "nibbles matrix
    Nibbles[0] = ((currentByte & 0xC0) >> 6);
    Nibbles[1] = ((currentByte & 0x30) >> 4);
    Nibbles[2] = ((currentByte & 0x0C) >> 2);
    Nibbles[3] = (currentByte & 0x03);

    //print each pixel in the group of four in the right colors as referenced by the palette
    for(int k = 0; k<(4); k++)
    {
     matrix.drawPixel(i, ((4*j)+k), matrix.Color888(Red[Nibbles[k]],Grn[Nibbles[k]],Blu[Nibbles[k]]));
      // matrix.drawPixel(i, (4*j+k), matrix.Color333(0,0,6));
       //Serial.print(Nibbles[k],DEC);
    }
  }
}
}

void loop() {

}



